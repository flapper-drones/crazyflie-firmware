## configs/flapper3_revB_defconfig
```kconfig
CONFIG_PLATFORM_FLAPPER3=y

CONFIG_ESTIMATOR_AUTO_SELECT=y
CONFIG_CONTROLLER_PID=y

CONFIG_MOTORS_ESC_PROTOCOL_STANDARD_PWM=y

CONFIG_CONTROLLER_PID_FILTER_ALL=y

CONFIG_DECK_FORCE="bcUSD:bcLedRing"
CONFIG_DECK_USD=y
CONFIG_DECK_LEDRING=y

CONFIG_POWER_DISTRIBUTION_FLAPPER3_REVB=y
CONFIG_POWER_DISTRIBUTION_FLAPPER3_SERVO_INVERTED=y
```
