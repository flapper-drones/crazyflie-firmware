## configs/bolt_defconfig
```kconfig
CONFIG_PLATFORM_BOLT=y

CONFIG_ESTIMATOR_ANY=y
CONFIG_CONTROLLER_ANY=y

CONFIG_DECK_FORCE="bcUSD"
CONFIG_DECK_USD=y
```

## configs/flapper3_defconfig
```kconfig
CONFIG_PLATFORM_FLAPPER3=y

CONFIG_ESTIMATOR_AUTO_SELECT=y
CONFIG_CONTROLLER_PID=y

CONFIG_MOTORS_ESC_PROTOCOL_STANDARD_PWM=y

CONFIG_CONTROLLER_PID_FILTER_ALL=y
```

## configs/flapper_defconfig
```kconfig
CONFIG_PLATFORM_FLAPPER=y

CONFIG_ESTIMATOR_ANY=y
CONFIG_CONTROLLER_PID=y

CONFIG_DECK_FORCE="bcUSD:bcLedRing:bcCurrentDeck:bcCPPM"
CONFIG_DECK_CPPM=y
CONFIG_DECK_CURRENT=y
CONFIG_DECK_USD=y
CONFIG_DECK_LEDRING=y

CONFIG_DECK_CPPM_USE_PA3=y
```

## configs/octo_defconfig
```kconfig
CONFIG_PLATFORM_OCTO=y

CONFIG_ESTIMATOR_ANY=y
CONFIG_CONTROLLER_PID=y

CONFIG_MOTORS_ESC_PROTOCOL_STANDARD_PWM=y
```
